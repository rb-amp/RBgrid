## components/rbpower/Kconfig
```kconfig
menu "RBPower Configuration"

    config RBPOWER_VERBOSE_DEBUG
        bool "Enable RBPower Verbose Debug Logging"
        default n
        help
            Enable extremely detailed verbose debug logging for RBPower modules:
            - Flash operations: detailed buffer state, sector transitions
            - Runtime config: slot allocation, metadata operations
            - Statistics: record-level tracking and cache operations

            WARNING: This produces MASSIVE log output and should ONLY be
            enabled when debugging specific Flash or statistics issues.
            This will significantly impact performance.

    menu "RBgrid interfaces (build keys)"
        config RBGRID_IF_WIFI
            bool "Wi-Fi (STA + setup access point) owned by RBgrid"
            default y
            help
                Off when a host (e.g. ESPHome) owns Wi-Fi. NVS, netif and the default event loop are then
                expected from the host (RBgrid tolerates them being initialised already).
        config RBGRID_IF_HTTP
            bool "HTTP server: REST API, WebSocket telemetry, web app hosting, OTA upload"
            depends on RBGRID_IF_WIFI
            default y
        config RBGRID_IF_MQTT
            bool "MQTT client: telemetry, command channel, Home Assistant discovery"
            default y
        config RBGRID_IF_SNTP
            bool "SNTP client owned by RBgrid"
            default y
            help
                Off when a host keeps the system clock (ESPHome `time: sntp`): RBgrid then starts no SNTP of its
                own, takes the system clock once it is real (not before the build day), and still runs its
                after-sync steps (clock-step flag, pending records, statistics timers).
        config RBGRID_IF_MDNS
            bool "mDNS announcement (rbgrid-xxxx.local, _rbgrid._tcp)"
            depends on RBGRID_IF_WIFI
            default y
    endmenu

    config RBGRID_POLL_TASK_PRIORITY
        int "rbAmp poll task priority (above idle)"
        range 1 10
        default 1
        help
            FreeRTOS priority of the rbAmp metering poll task (core 1), counted above idle. 1 in the standalone
            firmware, where core 1 is otherwise free. A host that runs its own loop on core 1 (ESPHome: loopTask,
            priority 1) sets it higher (5), so the poll cadence and the energy timestamps don't wait for the host.

    config RBGRID_EXTFLASH_TEST_MIN_KB
        int "Bench only: adopt an external statistics chip smaller than the internal region (KB, 0 = off)"
        range 0 16384
        default 0
        help
            0 (product): the external chip takes the statistics only when its region is larger than the internal
            stats partition. A bench build sets e.g. 1024 to test with a 4 MB chip; the one-time copy then refuses
            (statistics stay internal) if the recorded history does not fit on the chip.

    config RBGRID_PANIC_FORENSICS
        bool "Record the crash PC/backtrace in RTC memory for the next boot's event log"
        default y
        help
            Wraps esp_panic_handler (linker --wrap). Turn off when the host has its own panic wrapper
            (ESPHome's crash handler); the boot line then shows only the reset reason.

    config RBGRID_NVS_PARTITION
        string "NVS partition for RBgrid data"
        default "nvs"
        help
            NVS partition that holds RBgrid's own data: lifetime energy anchors, the open hour, net metering,
            migration flags, the ESP-NOW key / node settings, rbAmp anchors, OTA rollback notes.
            "nvs" (default, the product image): the default NVS partition, as on every installed hub.
            Another label (e.g. "rbnvs" in a build hosted by ESPHome) keeps this data in its own partition,
            so a host that erases the default NVS cannot take it. The partition must exist in the partition
            table. Wi-Fi credentials and the Wi-Fi driver's own data stay in the default "nvs".

    config RBGRID_LED_GREEN_GPIO
        int "Status LED: green GPIO (-1 = none)"
        range -1 48
        default 4 if IDF_TARGET_ESP32S3
        default -1
        help
            Green status LED (active high). The hub's state: setup, Wi-Fi, pairing windows, heartbeat.
    config RBGRID_LED_RED_GPIO
        int "Status LED: red GPIO (-1 = none)"
        range -1 48
        default 5 if IDF_TARGET_ESP32S3
        default -1
        help
            Red status LED (active high). Faults, warnings and events as numbered flash groups.

endmenu # RBPower Configuration
```
